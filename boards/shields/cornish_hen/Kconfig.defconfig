## boards/shields/cornish_hen/Kconfig.defconfig
```kconfig
if SHIELD_CORNISH_HEN_LEFT

# Name must be less than 16 characters long!
config ZMK_KEYBOARD_NAME
    default "Cornish Hen"

config ZMK_SPLIT_ROLE_CENTRAL
    default y

config ZMK_SPLIT_BLE_CENTRAL_PERIPHERALS
  default 1

config BT_MAX_CONN
  default 6

config BT_MAX_PAIRED
  default 6

endif

if SHIELD_CORNISH_HEN_LEFT || SHIELD_CORNISH_HEN_RIGHT

config ZMK_SPLIT
    default y

endif
```

## boards/shields/cornish_hen/Kconfig.shield
```kconfig
config SHIELD_CORNISH_HEN_LEFT
    def_bool $(shields_list_contains,cornish_hen_left)
  
config SHIELD_CORNISH_HEN_RIGHT
    def_bool $(shields_list_contains,cornish_hen_right)
  
```
